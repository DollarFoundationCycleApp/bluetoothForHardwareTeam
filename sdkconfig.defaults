## sdkconfig.defaults
```kconfig
CONFIG_FREERTOS_HZ=1000
CONFIG_BT_ENABLED=y
CONFIG_BT_NIMBLE_ENABLED=y
CONFIG_ESPTOOLPY_FLASHSIZE_8MB=y
CONFIG_BT_NIMBLE_HOST_TASK_STACK_SIZE=16384
CONFIG_BT_NIMBLE_MSYS_1_BLOCK_SIZE=512
CONFIG_BT_NIMBLE_MSYS_1_BLOCK_COUNT=64
CONFIG_FATFS_LFN_STACK=y
CONFIG_FATFS_LFN_MAX_LFN_LEN=255
```
